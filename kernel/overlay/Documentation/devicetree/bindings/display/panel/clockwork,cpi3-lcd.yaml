## kernel/overlay/Documentation/devicetree/bindings/display/panel/clockwork,cpi3-lcd.yaml
```yaml
# SPDX-License-Identifier: (GPL-2.0-only OR BSD-2-Clause)
%YAML 1.2
---
$id: http://devicetree.org/schemas/display/panel/clockwork,cpi3-lcd.yaml#
$schema: http://devicetree.org/meta-schemas/core.yaml#
title: ClockworkPi GameShell 320x240 RGB666 panel
maintainers:
  - Michael Ishri <michael.ishri@gmail.com>
description: |
  The built-in GameShell panel uses parallel RGB666 for pixels and a
  write-only SPI mode 3 control interface. Its historical KD027 name does
  not identify a verified controller model. Reset is active low.
allOf:
  - $ref: panel-common.yaml#
  - $ref: /schemas/spi/spi-peripheral-props.yaml#
properties:
  compatible:
    const: clockwork,cpi3-lcd
  reg:
    maxItems: 1
  spi-max-frequency:
    maximum: 100000
  spi-cpol: true
  spi-cpha: true
  reset-gpios:
    maxItems: 1
  power-supply: true
  backlight: true
  port: true
required:
  - compatible
  - reg
  - spi-cpol
  - spi-cpha
  - reset-gpios
  - power-supply
  - backlight
  - port
unevaluatedProperties: false
```

## kernel/overlay/Documentation/devicetree/bindings/leds/backlight/ocs,ocp8178.yaml
```yaml
# SPDX-License-Identifier: (GPL-2.0-only OR BSD-2-Clause)
%YAML 1.2
---
$id: http://devicetree.org/schemas/leds/backlight/ocs,ocp8178.yaml#
$schema: http://devicetree.org/meta-schemas/core.yaml#
title: Orient Chip OCP8178 one-wire backlight controller
maintainers:
  - Michael Ishri <michael.ishri@gmail.com>
description: |
  A GPIO-controlled backlight with 31 nonzero brightness codes. Code zero
  requests shutdown; the driver holds CTRL low rather than leaving the
  boost converter enabled. GPIO must support non-sleeping access.
allOf:
  - $ref: common.yaml#
properties:
  compatible:
    const: ocs,ocp8178
  ctrl-gpios:
    maxItems: 1
  default-brightness:
    $ref: /schemas/types.yaml#/definitions/uint32
    minimum: 0
    maximum: 31
    default: 1
required:
  - compatible
  - ctrl-gpios
unevaluatedProperties: false
```
